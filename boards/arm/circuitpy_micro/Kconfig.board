## boards/arm/circuitpy_micro/Kconfig.board
```kconfig
# Southpaw Design Circuitpy Micro board configuration

# Copyright (c) 2021 Pete Johanson
# SPDX-License-Identifier: Apache-2.0

config BOARD_CIRCUITPY_MICRO
	bool "Southpaw Design CircuitPy Micro"
	depends on SOC_PART_NUMBER_SAMD21E18A
```

## boards/arm/circuitpy_micro/Kconfig.defconfig
```kconfig
# Southpaw Design Circuitfpy Micro board configuration 
# Copyright (c) 2021 Pete Johanson
# SPDX-License-Identifier: Apache-2.0

config BOARD
	default "circuitpy_micro"
	depends on BOARD_CIRCUITPY_MICRO
```

## boards/arm/circuitpy_micro/circuitpy_micro_defconfig
```kconfig
# SPDX-License-Identifier: Apache-2.0

CONFIG_SOC_SERIES_SAMD21=y
CONFIG_SOC_PART_NUMBER_SAMD21E18A=y
CONFIG_BOARD_CIRCUITPY_MICRO=y
CONFIG_CORTEX_M_SYSTICK=y
CONFIG_PINMUX=y
CONFIG_BOOTLOADER_BOSSA=y
CONFIG_BOOTLOADER_BOSSA_ADAFRUIT_UF2=y
```
